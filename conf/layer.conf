## conf/layer.conf
```bitbake
# We have a conf and classes directory, add to BBPATH
BBPATH .= ":${LAYERDIR}"

# We have recipes-* directories, add to BBFILES
BBFILES += "${LAYERDIR}/recipes-*/*/*.bb \
            ${LAYERDIR}/recipes-*/*/*.bbappend"

BBFILE_COLLECTIONS += "meta-yahboom"
BBFILE_PATTERN_meta-yahboom = "^${LAYERDIR}/"
BBFILE_PRIORITY_meta-yahboom = "6"

LAYERDEPENDS_meta-yahboom = "core"
LAYERSERIES_COMPAT_meta-yahboom = "kirkstone"
```
